## laser_controller/code/ad7606_diagnostic/sdkconfig.defaults
```kconfig
CONFIG_ESPTOOLPY_FLASHMODE_DIO=y
CONFIG_ESPTOOLPY_FLASHFREQ_80M=y
CONFIG_ESPTOOLPY_FLASHSIZE_16MB=y
CONFIG_PARTITION_TABLE_SINGLE_APP=y
CONFIG_ESP_CONSOLE_UART_DEFAULT=y
CONFIG_ESP_CONSOLE_UART_BAUDRATE=115200
CONFIG_COMPILER_OPTIMIZATION_PERF=y
```

## laser_controller/code/main/Kconfig.projbuild
```kconfig
menu "Vivonics laser-controller bring-up"

config LC_AD7606_SCLK_HZ
    int "AD7606 serial clock (Hz)"
    range 1000000 10000000
    default 10000000
    help
        Conservative first-article limit. Do not exceed 10 MHz without new
        timing and rail-margin evidence.

config LC_AD7606_SAMPLE_RATE_HZ
    int "Bring-up sample rate (samples/s)"
    range 1 1000
    default 1000
    help
        The initial firmware deliberately caps the task-driven sampling loop at
        1 kSPS. The selected rate must divide the 1000 Hz FreeRTOS tick exactly.
        Higher rates require a timer/DMA design and measured integrity.

config LC_AD7606_BUSY_TIMEOUT_US
    int "BUSY edge timeout (microseconds)"
    range 10 10000
    default 100

config LC_AD7606_LOG_EVERY_N
    int "Log every Nth conversion (0 disables sample logging)"
    range 0 1000000
    default 0
    help
        UART logging is synchronous and counts against the sampling deadline.
        Leave disabled at 1 kSPS. Lower the sample rate before enabling logs for
        known-input bring-up work.

config LC_STRICT_SAMPLE_DEADLINE
    bool "Latch a safety fault when a sample deadline is missed"
    default y
    help
        Keep enabled for measurement-only and validation profiles. The
        network dashboard profile reports overruns as diagnostics instead of
        latching because Wi-Fi and HTTP tasks are intentionally nondeterministic.

config LC_ENABLE_LASER_PULSE_TEST
    bool "Enable local laser output test commands"
    default n
    help
        Keep disabled in normal and measurement-validation builds. The separate
        laser-test profile accepts local native-USB commands without a FACT
        hold and permits one channel or the explicit IR-plus-green test target.
        PULSE commands are bounded to 900 ms. ON commands remain active until
        OFF, reset, overcurrent, or an ADC/telemetry fault while continuous
        monitoring remains active.

config LC_ENABLE_WEB_DASHBOARD
    bool "Enable the Wi-Fi dashboard and browser OTA surface"
    depends on LC_ENABLE_LASER_PULSE_TEST
    default n
    help
        Adds the access-controller-derived embedded dashboard, Wi-Fi AP/STA
        provisioning, live ADC APIs, remote first-article laser commands, and
        dual-partition browser OTA. Keep disabled in measurement-only builds.

endmenu
```

## laser_controller/code/sdkconfig.defaults
```kconfig
CONFIG_IDF_TARGET="esp32s3"
CONFIG_ESPTOOLPY_FLASHSIZE_16MB=y
CONFIG_ESPTOOLPY_FLASHSIZE="16MB"
CONFIG_FREERTOS_HZ=1000
CONFIG_ESP_MAIN_TASK_STACK_SIZE=8192
CONFIG_COMPILER_OPTIMIZATION_SIZE=y
CONFIG_BOOTLOADER_COMPILE_TIME_DATE=n
CONFIG_APP_COMPILE_TIME_DATE=n
CONFIG_APP_PROJECT_VER_FROM_CONFIG=y
CONFIG_APP_PROJECT_VER="0.1.0-bringup"
CONFIG_BOOTLOADER_LOG_LEVEL_WARN=y
CONFIG_LOG_DEFAULT_LEVEL_INFO=y
```
